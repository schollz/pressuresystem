/****************************************************************************** 
MCP4725 Example Waveform Sketch
Joel Bartlett
SparkFun Electronics
Sept. 11, 2014
https://github.com/sparkfun/MCP4725_Breakout

This sketch takes data from a lookup table to provide 
waveforms to be generated by the MCP4725 DAC. 

Development environment specifics:
Arduino 1.0+
Hardware Version V14

This code is beerware; if you see me (or any other SparkFun employee) at the local, 
and you've found our code helpful, please buy us a round!

Distributed as-is; no warranty is given. 

This code builds off the sketch written by Mark VandeWettering, which can be found here:
http://brainwagon.org/2011/02/24/arduino-mcp4725-breakout-board/
*/

#include <Wire.h>

#define MCP4725_ADDR 0x60   

String sdata = ""; // Initialised to nothing.
bool started = false;

void setup()
{
    Serial.begin(9600);
  Wire.begin();
    pinMode(2, OUTPUT);
  pinMode(3, OUTPUT);
  Serial.println("Begin");

}



void loop(void) {
  if (started == false) {
    started = true;
    setVoltage(0);
    digitalWrite(2, LOW);
    digitalWrite(3, LOW);
  }
  byte ch;
  if (Serial.available()) {
    ch = Serial.read();
    sdata += (char)ch;
    if (ch == '\n') {
      sdata.trim();
      if (sdata.indexOf("voltage") > -1) {
        sdata.remove(0, 7);
        float newVal = sdata.toFloat();
        // set voltage
        float newVoltage = round(4095.0/3.3/2.0* newVal);
        if (newVoltage > 4095) {
          newVoltage = 4095;
        }
        int newVolts = uint16_t(newVoltage);
        setVoltage(int(newVolts));
        Serial.println(newVolts);
      } else if (sdata.indexOf("read") > -1) {
        Serial.println(analogRead(A3));
      } else if (sdata.indexOf("sol1") > -1) {
        if (sdata.indexOf("on") > -1) {
          digitalWrite(2, HIGH);
          Serial.println("sol1on");
        } else {
          digitalWrite(2, LOW);
          Serial.println("sol1off");
        }
      } else if (sdata.indexOf("sol2") > -1) {
        if (sdata.indexOf("on") > -1) {
          digitalWrite(3, HIGH);
          Serial.println("sol2on");
        } else {
          digitalWrite(3, LOW);
          Serial.println("sol2off");
        }
      } else {
        Serial.println("?");
      }
      sdata = "";
    }
  }
}

void setVoltage(int value)
{
  Wire.beginTransmission(MCP4725_ADDR);
  Wire.write(64);                     // cmd to update the DAC
  Wire.write(value >> 4);        // the 8 most significant bits...
  Wire.write((value & 15) << 4); // the 4 least significant bits...
  Wire.endTransmission();
}
